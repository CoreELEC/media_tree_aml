## drivers/media/platform/meson/dvb/Kconfig
```kconfig
#
# Meson dvb driver configuration
#

menu "Meson dvb drivers"

config MESON_DVB
	tristate "Meson dvb drivers"
	default n
	select DVB_CORE
	help
		Select to enable Meson dvb drivers.
config DVB_DS3K
	tristate "Montage Tehnology TS202x/DS300x/DS3103 based"
	depends on DVB_CORE && I2C
	default m if !MEDIA_SUBDRV_AUTOSELECT
	help
	  A DVB-S/S2 tuner module. Say Y when you want to support this frontend.

endmenu
```
